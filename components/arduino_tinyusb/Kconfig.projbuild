## components/arduino_tinyusb/Kconfig.projbuild
```kconfig
menu "Arduino TinyUSB"

    config TINYUSB_ENABLED
        bool "Enable TinyUSB driver"
        default y
        depends on IDF_TARGET_ESP32S2 || IDF_TARGET_ESP32S3
        select FREERTOS_SUPPORT_STATIC_ALLOCATION
        help
            Add the Arduino TinyUSB device stack used by USBCDC. Required for
            the USB CDC `Serial` console on ESP32-S2.

    if TINYUSB_ENABLED
        menu "Serial (CDC) driver"
            config TINYUSB_CDC_ENABLED
                bool "Enable USB Serial (CDC) TinyUSB driver"
                default y
                help
                    Enable the USB CDC ACM class so Arduino's USBCDC object exists.

            config TINYUSB_DESC_CDC_STRING
                string "CDC Device String"
                default "Espressif CDC Device"
                depends on TINYUSB_CDC_ENABLED

            config TINYUSB_CDC_RX_BUFSIZE
                int "CDC FIFO size of RX"
                default 64
                range 64 10000
                depends on TINYUSB_CDC_ENABLED

            config TINYUSB_CDC_TX_BUFSIZE
                int "CDC FIFO size of TX"
                default 64
                depends on TINYUSB_CDC_ENABLED
        endmenu

        config TINYUSB_DEBUG_LEVEL
            int "TinyUSB log level (0-3)"
            default 0
            range 0 3
    endif

endmenu
```
